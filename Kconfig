## Kconfig
```kconfig
# Copyright (c) 2024 The ZMK Contributors
# SPDX-License-Identifier: MIT

# Required for macros to function
config SYSTEM_WORKQUEUE_STACK_SIZE
    default 2048 if SOC_SERIES_STM32F4X
```

## boards/extensions/pillbug/board.yml
```yaml
board:
  extend: pillbug
  revision:
    format: major.minor.patch
    default: 1.0.0
    revisions:
      - name: 1.0.0
      - name: 0.1.0
```

## boards/shields/bb40/Kconfig.defconfig
```kconfig
# Copyright (c) 2023 The ZMK Contributors
# SPDX-License-Identifier: MIT

if SHIELD_BB40

config ZMK_KEYBOARD_NAME
    default "BB40"

config ZMK_SLEEP
    default y
    depends on SOC_SERIES_NRF52X #TODO: Keep an eye on this, suspect ZMK proper will institute better guarding when people actually start trying RP2040s

if ZMK_BACKLIGHT

config PWM
    default y if DT_HAS_PWM_LEDS_ENABLED

# TODO: For some reason ZMK lights *all* the LEDs, even the one on the PillBug. Disable GPIO LEDs if the PWM ones are in effect to avoid this
# TODO: Find out if this also happens on BlackPills
# TODO: Find out why it happens and fix whatever the problem is
config LED_GPIO
    default n if LED_PWM

endif

## TODO: Won't work without a ZMK PR.
## Unless someone has intentionally chosen their own thread, default to the global thread if an EC11 encoder exists to cut down on boilerplate
#choice EC11_TRIGGER_MODE
#    default EC11_TRIGGER_GLOBAL_THREAD
#    depends on EC11
#endchoice

config EC11
    default n if NRFX_QDEC

# Add delays for BlackPill to stop double matrix reads on first row
if SOC_FAMILY_STM32

config ZMK_KSCAN_MATRIX_WAIT_BEFORE_INPUTS
    default 150

config ZMK_KSCAN_MATRIX_WAIT_BETWEEN_OUTPUTS
    default 150

endif

endif
```

## boards/shields/bb40/Kconfig.shield
```kconfig
# Copyright (c) 2023 The ZMK Contributors
# SPDX-License-Identifier: MIT

config SHIELD_BB40
    def_bool $(shields_list_contains,bb40)
```

## boards/shields/bb65/Kconfig.defconfig
```kconfig
# Copyright (c) 2023 The ZMK Contributors
# SPDX-License-Identifier: MIT

if SHIELD_BB65

config ZMK_KEYBOARD_NAME
    default "BB65"

config ZMK_SLEEP
    default y
    # TODO:
    # - Keep an eye on this, suspect ZMK proper will institute better guarding when people actually start trying RP2040s
    # - F4x1s do have low-power modes...
    depends on SOC_SERIES_NRF52X

config ZMK_RGB_UNDERGLOW
    default y
    # DI pin is A1, so RGB LEDs cannot be enabled for F401 until someone writes a compatible bitbang (gpio) or pwm binding
    #depends on SOC_STM32F411XE
    # TODO: ...except right now ZMK blindly assumes you have external power control, so RGB can't be enabled AT ALL for STM without forcing CONFIG_ZMK_RGB_UNDERGLOW_EXT_POWER=n. Grand!
    depends on !SOC_FAMILY_STM32
    imply WS2812_STRIP

# TODO: Won't work without a ZMK PR.
# Unless someone has intentionally chosen their own thread, default to the global thread if an EC11 encoder exists to cut down on boilerplate
choice EC11_TRIGGER_MODE
    default EC11_TRIGGER_GLOBAL_THREAD
    depends on EC11
endchoice

config EC11
    default n if NRFX_QDEC

# Add delays for BlackPill to stop double matrix reads on first row
if SOC_FAMILY_STM32

# Features such as macros crash the board with a smaller stack size.
config SYSTEM_WORKQUEUE_STACK_SIZE
    default 2048

config EC11_THREAD_STACK_SIZE
    default 2048 if EC11_TRIGGER_OWN_THREAD

#config ZMK_KSCAN_MATRIX_WAIT_BEFORE_INPUTS
#    default 1
#
#config ZMK_KSCAN_MATRIX_WAIT_BETWEEN_OUTPUTS
#    default 1

endif

endif
```

## boards/shields/bb65/boards/blackpill_f401ce.conf
```kconfig
# Necessary to stop double matrix reads on first row
CONFIG_ZMK_KSCAN_MATRIX_WAIT_BEFORE_INPUTS=150
CONFIG_ZMK_KSCAN_MATRIX_WAIT_BETWEEN_OUTPUTS=150
# DI pin is A1, so RGB LEDs cannot be enabled for BlackPill
# ...until someone writes a compatible bitbang (gpio) or pwm binding
CONFIG_ZMK_RGB_UNDERGLOW=n
CONFIG_WS2812_STRIP=n

# BlackPill cannot deep sleep
CONFIG_ZMK_SLEEP=n
```

## boards/shields/bbpad/Kconfig.defconfig
```kconfig
# Copyright (c) 2023 The ZMK Contributors
# SPDX-License-Identifier: MIT

if SHIELD_BBPAD

config ZMK_KEYBOARD_NAME
    default "BBPad"

config ZMK_SLEEP
    default y
    depends on SOC_SERIES_NRF52X #TODO: Keep an eye on this, suspect ZMK proper will institute better guarding when people actually start trying RP2040s

config ZMK_RGB_UNDERGLOW
    default y
    # DI pin is B6, so RGB LEDs cannot be enabled for BlackPill until someone writes a compatible bitbang (gpio) or pwm binding
    depends on !SOC_SERIES_STM32F4X
    imply WS2812_STRIP

# Unless someone has intentionally chosen their own thread, default to the global thread if an EC11 encoder exists to cut down on boilerplate
choice EC11_TRIGGER_MODE
    default EC11_TRIGGER_GLOBAL_THREAD
    depends on EC11
endchoice

config EC11
    default n if NRFX_QDEC

# Add delays for BlackPill to stop double matrix reads on first row
if SOC_FAMILY_STM32

config ZMK_KSCAN_MATRIX_WAIT_BEFORE_INPUTS
    default 150

config ZMK_KSCAN_MATRIX_WAIT_BETWEEN_OUTPUTS
    default 150

endif

endif
```

## boards/shields/bbpad/Kconfig.shield
```kconfig
# Copyright (c) 2023 The ZMK Contributors
# SPDX-License-Identifier: MIT

config SHIELD_BBPAD
    def_bool $(shields_list_contains,bbpad)
```

## boards/shields/bbpad/boards/blackpill_f411ce.conf
```kconfig
# DI pin is B6, so RGB LEDs cannot be enabled for BlackPill
# ...until someone writes a compatible bitbang (gpio) or pwm binding
CONFIG_ZMK_RGB_UNDERGLOW=n
CONFIG_WS2812_STRIP=n

CONFIG_ZMK_SLEEP=n
```

## boards/shields/bde_rev2/Kconfig.defconfig
```kconfig
# Copyright (c) 2022 The ZMK Contributors
# SPDX-License-Identifier: MIT

if SHIELD_BDE_REV2

config ZMK_KEYBOARD_NAME
    default "BDE Rev2"

config ZMK_SLEEP
    default y
    depends on SOC_SERIES_NRF52X #TODO: Keep an eye on this, suspect ZMK proper will institute better guarding when people actually start trying RP2040s

config ZMK_RGB_UNDERGLOW
    default y
    depends on SOC_SERIES_NRF52X #TODO: Keep an eye on this
    imply WS2812_STRIP

config ZMK_DISPLAY
    default y

if ZMK_DISPLAY

config I2C
    default y

config SSD1306
    default y

endif # ZMK_DISPLAY

if LVGL

config LV_Z_VDB_SIZE
    default 64

config LV_DPI_DEF
    default 148

config LV_Z_BITS_PER_PIXEL
    default 1

choice LV_COLOR_DEPTH
    default LV_COLOR_DEPTH_1
endchoice

endif # LVGL

endif
```

## boards/shields/bde_rev2/Kconfig.shield
```kconfig
# Copyright (c) 2022 The ZMK Contributors
# SPDX-License-Identifier: MIT

config SHIELD_BDE_REV2
    def_bool $(shields_list_contains,bde_rev2)
```

## boards/shields/mokulua/Kconfig.defconfig
```kconfig
#Copyright (c) 2023 The ZMK Contributors
#SPDX-License-Identifier: MIT

if SHIELD_MOKULUA_LEFT

config ZMK_KEYBOARD_NAME
    default "Mokulua"

config ZMK_SPLIT_ROLE_CENTRAL
    default y

endif

if SHIELD_MOKULUA_LEFT || SHIELD_MOKULUA_RIGHT

config ZMK_SPLIT
    default y

config ZMK_SLEEP
    default y
    depends on SOC_SERIES_NRF52X #TODO: Keep an eye on this, suspect ZMK proper will institute better guarding when people actually start trying RP2040s

config ZMK_RGB_UNDERGLOW
    default y
    depends on SOC_SERIES_NRF52X #TODO: Keep an eye on this
    imply WS2812_STRIP

# Unless someone has intentionally chosen their own thread, default to the global thread if an EC11 encoder exists to cut down on boilerplate
choice EC11_TRIGGER_MODE
    default EC11_TRIGGER_GLOBAL_THREAD
    depends on EC11
endchoice

config ZMK_DISPLAY
    default y

if ZMK_DISPLAY

config I2C
    default y

config SSD1306
    default y

endif # ZMK_DISPLAY

if LVGL

config LV_Z_VDB_SIZE
    default 64

config LV_DPI_DEF
    default 148

config LV_Z_BITS_PER_PIXEL
    default 1

choice LV_COLOR_DEPTH
    default LV_COLOR_DEPTH_1
endchoice

endif # LVGL

endif
```

## boards/shields/obe/Kconfig.defconfig
```kconfig
# Copyright (c) 2023 The ZMK Contributors
# SPDX-License-Identifier: MIT

if SHIELD_OBE

config ZMK_KEYBOARD_NAME
    default "OrangeBoyErgo"

config ZMK_SLEEP
    default y
    depends on SOC_SERIES_NRF52X #TODO: Keep an eye on this, suspect ZMK proper will institute better guarding when people actually start trying RP2040s

config ZMK_RGB_UNDERGLOW
    default y
    # DI pin is A0, so RGB LEDs cannot be enabled for BlackPill until someone writes a compatible bitbang (gpio) or pwm binding
    depends on !SOC_SERIES_STM32F4X
    imply WS2812_STRIP

if ZMK_BACKLIGHT

config PWM
    default y if DT_HAS_PWM_LEDS_ENABLED

# TODO: For some reason ZMK lights *all* the LEDs, even the one on the PillBug. Disable GPIO LEDs if the PWM ones are in effect to avoid this
# TODO: Find out if this also happens on BlackPills
# TODO: Find out why it happens and fix whatever the problem is
config LED_GPIO
    default n if LED_PWM

endif

# Unless someone has intentionally chosen their own thread, default to the global thread if an EC11 encoder exists to cut down on boilerplate
choice EC11_TRIGGER_MODE
    default EC11_TRIGGER_GLOBAL_THREAD
    depends on EC11
endchoice

config EC11
    default n if NRFX_QDEC

# Add delays for BlackPill to stop double matrix reads
if SOC_FAMILY_STM32

# Features such as macros crash the board with a smaller stack size.
config SYSTEM_WORKQUEUE_STACK_SIZE
    default 2048

config EC11_THREAD_STACK_SIZE
    default 2048 if EC11_TRIGGER_OWN_THREAD

config ZMK_KSCAN_MATRIX_WAIT_BEFORE_INPUTS
    default 150

config ZMK_KSCAN_MATRIX_WAIT_BETWEEN_OUTPUTS
    default 150

endif

endif
```

## boards/shields/puckbuddy/Kconfig.defconfig
```kconfig
# Copyright (c) 2024 The ZMK Contributors
# SPDX-License-Identifier: MIT

if SHIELD_PUCKBUDDY

config ZMK_KEYBOARD_NAME
    default "PuckBuddy"

config ZMK_SLEEP
    default y
    depends on SOC_SERIES_NRF52X #TODO: Keep an eye on this, suspect ZMK proper will institute better guarding when people actually start trying RP2040s

config ZMK_RGB_UNDERGLOW
    default y
    # DI pin is A3, so RGB LEDs cannot be enabled for BlackPill until someone writes a compatible bitbang (gpio) or pwm binding
    depends on !SOC_SERIES_STM32F4X
    imply WS2812_STRIP

config ZMK_DISPLAY
    default y

config ZMK_MOUSE
    default y

# INPUT and SPI both needed for Cirque
config INPUT
    default y

config SPI
    default y

if ZMK_DISPLAY

config I2C
    default y

config SSD1306
    default y

# Required for OLED to function
config SYSTEM_WORKQUEUE_STACK_SIZE
    default 2048 if ( SOC_SERIES_STM32F4X && !ZMK_DISPLAY_WORK_QUEUE_DEDICATED)

endif # ZMK_DISPLAY

if LVGL

config LV_Z_VDB_SIZE
    default 64

config LV_DPI_DEF
    default 148

config LV_Z_BITS_PER_PIXEL
    default 1

choice LV_COLOR_DEPTH
    default LV_COLOR_DEPTH_1
endchoice

endif # LVGL

## TODO: Won't work without a ZMK PR.
## Unless someone has intentionally chosen their own thread, default to the global thread if an EC11 encoder exists to cut down on boilerplate
#choice EC11_TRIGGER_MODE
#    default EC11_TRIGGER_GLOBAL_THREAD
#    depends on EC11
#endchoice

# Add delays for BlackPill to stop double matrix reads on first row
# Do we (still) need this?
if SOC_SERIES_STM32F4X

config ZMK_KSCAN_MATRIX_WAIT_BEFORE_INPUTS
    default 150

config ZMK_KSCAN_MATRIX_WAIT_BETWEEN_OUTPUTS
    default 150

endif

endif
```

## boards/shields/puckbuddy/Kconfig.shield
```kconfig
# Copyright (c) 2024 The ZMK Contributors
# SPDX-License-Identifier: MIT

config SHIELD_PUCKBUDDY
    def_bool $(shields_list_contains,puckbuddy)
```

## boards/shields/sugarglider/Kconfig.shield
```kconfig
# Copyright (c) 2024 The ZMK Contributors
# SPDX-License-Identifier: MIT

config SHIELD_SUGARGLIDER
    def_bool $(shields_list_contains,sugarglider)
```

## boards/shields/waka60/Kconfig.defconfig
```kconfig
# Copyright (c) 2023 The ZMK Contributors
# SPDX-License-Identifier: MIT

if SHIELD_WAKA60

    config ZMK_KEYBOARD_NAME
        default "Waka60"

    config ZMK_RGB_UNDERGLOW
        depends on ZMK_BOARD_PILLBUG

    config ZMK_SLEEP
        depends on ZMK_BOARD_PILLBUG

endif
```

## boards/shields/waka60/Kconfig.shield
```kconfig
# Copyright (c) 2023 The ZMK Contributors
# SPDX-License-Identifier: MIT

config SHIELD_WAKA60
    def_bool $(shields_list_contains,waka60)
```

## boards/shields/waka60/boards/blackpill_f411ce.conf
```kconfig
# DI pin is A1, so RGB LEDs cannot be enabled for BlackPill
# ...until someone writes a compatible bitbang (gpio) or pwm binding
CONFIG_ZMK_RGB_UNDERGLOW=n
CONFIG_WS2812_STRIP=n

# BlackPill cannot deep sleep
CONFIG_ZMK_SLEEP=n
```

## dts/bindings/mechwild,indicators.yaml
```yaml
# Copyright (c) 2024 The ZMK Contributors
# SPDX-License-Identifier: MIT

#include <dt-bindings/zmk/hid_usage.h>

# This should probably be split into multiple bindings: a parent for the LED indicator and what it does when triggered, plus "children" for stuff like HID vs more arbitrary stuff like BLE profiles and layers. We'll see how this goes, though.

compatible: "mechwild,indicators"

description: "HID and/or layer indicators. Maybe even arbitrary indicators ooooo"

child-binding:
  description: "A configuration for a given indicator"

  properties:
    dev:
      type: phandle
      required: true
    leds:
      type: int #eventually maybe an array, not sure if we're separating out led_strip vs single LEDs...
    hid-indicators:
      type: int
    layers:
      type: array
      default: [-1]
```
