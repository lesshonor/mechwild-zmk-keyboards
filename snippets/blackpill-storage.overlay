/*
 * Copyright (c) 2024 The ZMK Contributors
 *
 * SPDX-License-Identifier: MIT
 */

/ {
	/delete-node/ &boot_partition;
	/delete-node/ &slot0_partition;
	/delete-node/ &slot1_partition;
	/delete-node/ &scratch_partition;
};
