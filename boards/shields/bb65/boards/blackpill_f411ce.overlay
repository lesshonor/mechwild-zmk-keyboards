/*
 * Copyright (c) 2024 The ZMK Contributors
 *
 * SPDX-License-Identifier: MIT
 */

#include "bb65-stm32f4.dtsi"
#include <dt-bindings/led/led.h>

/* If you're reading this and getting ideas, &spi4 doesn't exist on F401. Sorry. */
&spi4 {
    status = "okay";
    pinctrl-0 = <&spi4_mosi_pa1>;
    pinctrl-names = "default";

    led_strip: ws2812@0 {
        compatible = "worldsemi,ws2812-spi";

        /* SPI */
        reg = <0>; /* ignored, but necessary for SPI bindings */
        spi-max-frequency = <4000000>;

        /* WS2812 */
        chain-length = <10>; /* number of LEDs */
        spi-one-frame = <0x70>;
        spi-zero-frame = <0x40>;

        color-mapping = <LED_COLOR_ID_GREEN LED_COLOR_ID_RED LED_COLOR_ID_BLUE>;
    };
};

/ {
    chosen {
        zmk,underglow = &led_strip;
    };
};
