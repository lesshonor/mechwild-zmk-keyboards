/*
 * Copyright (c) 2024 The ZMK Contributors
 *
 * SPDX-License-Identifier: MIT
 */

/* BlackPill board definition in Zephyr enables ADC1 on A1 and PWM4 on B6 and B7 by default */
&adc1 {
    status = "disabled";
};

&timers4 {
    status = "disabled";
};

/* TODO: EEPROM goes here, someday */
&i2c1 {
    status = "disabled";
    pinctrl-0 = <&i2c1_scl_pb6 &i2c1_sda_pb7>;
	clock-frequency = <I2C_BITRATE_FAST>;
};

/* TODO: QDEC? */
/*
&timers5 {
    status = "okay";

    qdec_encoder: qdec {
        status = "okay";
        pinctrl-0 = <&tim5_ch3_pa2 &tim5_ch4_pa3>;
        pinctrl-names = "default";
    };
};
*/
/* TODO: SPEAKER?!?!?! */
/*
&timers3
    status = "okay";

    speaker: pwm {
        status = "okay";
        pinctrl-0 = <&tim3_ch2_pb5>;
        pinctrl-names = "default";
    };
};
*/
